## arch/arm/hotplug/Kconfig
```kconfig
config CLUSTER_PLUG
        bool "Enable cluster-plug cpu hotplug driver"
        default n
        help
          CPU hotplug driver designed for ARM big.LITTLE systems where
          both the big and little CPUs are of the same type. On these
          systems, it preferable to normall use the big cluster, and
          only activate the little cluster for highly parallel loads.
          This hotplug implementation always keeps the big cluster
          online, and only activates the little cluster for heavy
          parallel loads.

config MSM_HOTPLUG
	bool "MSM hotplug driver"
	depends on HOTPLUG_CPU
	default y
	help
	  The MSM hotplug driver controls on-/offlining of additional cores based on current cpu load.
```
